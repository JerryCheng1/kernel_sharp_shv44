/* Copyright (c) 2018, The Linux Foundation. All rights reserved.
 *
 * This program is free software; you can redistribute it and/or modify
 * it under the terms of the GNU General Public License version 2 and
 * only version 2 as published by the Free Software Foundation.
 *
 * This program is distributed in the hope that it will be useful,
 * but WITHOUT ANY WARRANTY; without even the implied warranty of
 * MERCHANTABILITY or FITNESS FOR A PARTICULAR PURPOSE.  See the
 * GNU General Public License for more details.
 */

qcom,sharp-8150-1st {
	qcom,profile-revision = <24>;
	qcom,max-voltage-uv = <4350000>;
	qcom,fastchg-current-ma = <2200>;
	qcom,fg-cc-cv-threshold-mv = <4340>;
	qcom,nom-batt-capacity-mah = <3200>;
	qcom,batt-id-kohm = <47>;
	qcom,battery-beta = <4250>;
	qcom,therm-room-temp = <100000>;
	qcom,battery-type = "sharp";
	qcom,jeita-fcc-ranges = <0 100 1600000 111 450 2200000>;
	qcom,jeita-fv-ranges = <0 439 4350000 440 600 4200000>;
	qcom,jeita-soft-thresholds = <0x4CCC 0x20B8>;
	qcom,jeita-hard-thresholds = <0x58CD 0x14A2>;
	qcom,therm-coefficients = <0x2318 0xd0c 0xdaf7 0xc556 0x848d>;
	qcom,therm-center-offset = <0x70>;
	qcom,therm-pull-up = <100>;
	qcom,rslow-normal-coeffs = <0xc3 0xfd 0xdb 0x03>;
	qcom,rslow-low-coeffs = <0x72 0x04 0x8b 0xfa>;
	qcom,checksum = <0xD1BA>;
	qcom,gui-version = "PM855GUI - 1.0.0.13";
	qcom,fg-profile-data = [
		 09 00 60 00
		 6E ED 1D F2
		 D4 ED 00 00
		 29 C5 3E 9A
		 D7 87 35 B3
		 4A AC 8B 86
		 38 00 C3 FD
		 DB 03 88 0D
		 A7 03 CE 07
		 32 00 9F F2
		 DF F5 E8 E5
		 92 E2 1B CD
		 A4 C4 1F 1A
		 8A EA B7 D2
		 60 00 3D 00
		 3C 00 3F 00
		 41 00 3E 00
		 3D 00 3E 00
		 40 00 3C 00
		 35 00 60 00
		 28 00 33 00
		 3F 00 39 00
		 30 00 43 00
		 4B 64 3B 00
		 33 F8 29 00
		 60 F0 6B 00
		 77 00 8E 10
		 8D 10 7C 00
		 E6 20 C2 40
		 99 50 84 13
		 78 00 D8 00
		 19 1F 4D 0C
		 84 FB F1 04
		 DE 1B 93 0B
		 DA 0D 12 22
		 DE 17 AF 42
		 F3 55 38 02
		 72 13 A5 1F
		 95 05 52 0A
		 13 05 59 1C
		 D1 02 C9 0C
		 2D 0B 48 18
		 BF 22 D0 3D
		 70 52 79 14
		 B8 1F 8D ED
		 56 D2 80 DE
		 71 1C 50 D2
		 B8 05 3D C2
		 52 18 9F 92
		 02 84 1E AA
		 84 90 09 80
		 86 02 BF F4
		 B7 02 CD 04
		 00 00 8E ED
		 6F F3 E4 07
		 54 D5 DE C5
		 89 01 27 F0
		 9C D5 BD 03
		 35 05 A7 01
		 CE 07 32 00
		 8C 01 FA 02
		 4D 05 C0 00
		 2A 03 28 02
		 2E 01 7F 02
		 65 04 4C 00
		 36 00 44 00
		 4C 64 52 00
		 53 E8 54 F8
		 54 E0 53 00
		 57 08 57 10
		 4C 10 3A 00
		 43 28 43 48
		 49 58 4F 0D
		 3F 00 44 00
		 4B 08 58 F8
		 4D 00 43 00
		 3D 10 49 10
		 48 00 55 20
		 66 40 4C 58
		 52 0F 5A 00
		 66 00 59 08
		 D8 00 A6 1E
		 55 04 65 0A
		 19 0B 2A 1C
		 70 22 7E 44
		 AF 53 25 18
		 03 02 B1 05
		 C2 03 59 12
		 3F 0A FC 1F
		 78 05 5F 02
		 F1 04 61 1C
		 91 03 C0 05
		 34 02 63 18
		 51 03 C7 04
		 34 02 71 00
		 A1 1F B1 05
		 50 02 76 06
		 79 1C E3 02
		 9A 04 6A 03
		 8F 18 B9 02
		 C7 05 8B 02
		 74 00 70 01
		 C0 00 FA 00
		 A2 0C 00 00
	];
};
