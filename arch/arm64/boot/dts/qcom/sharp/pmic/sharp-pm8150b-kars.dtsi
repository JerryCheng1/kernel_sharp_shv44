/*
 * Copyright (c) 2017-2018, The Linux Foundation. All rights reserved.
 *
 * This program is free software; you can redistribute it and/or modify
 * it under the terms of the GNU General Public License version 2 and
 * only version 2 as published by the Free Software Foundation.
 *
 * This program is distributed in the hope that it will be useful,
 * but WITHOUT ANY WARRANTY; without even the implied warranty of
 * MERCHANTABILITY or FITNESS FOR A PARTICULAR PURPOSE.  See the
 * GNU General Public License for more details.
 */
/*****************************************/
/*  Add SHARP include                    */
/*****************************************/

/*****************************************/
/*  pm8150b: qcom,pm8150b alias            */
/*****************************************/

/*****************************************/
/*  pm8150b-gpios: qpnp-pin               */
/*****************************************/
&pm8150b_gpios {
	compatible = "qcom,spmi-gpio";
	reg = <0xc000 0xc00>;
	interrupts = <0x2 0xc0 0 IRQ_TYPE_NONE>,
			<0x2 0xc1 0 IRQ_TYPE_NONE>,
			<0x2 0xc4 0 IRQ_TYPE_NONE>,
			<0x2 0xc5 0 IRQ_TYPE_NONE>,
			<0x2 0xc7 0 IRQ_TYPE_NONE>,
			<0x2 0xc9 0 IRQ_TYPE_NONE>,
			<0x2 0xcb 0 IRQ_TYPE_NONE>;
	interrupt-names = "pm8150b_gpio1", "pm8150b_gpio2",
			"pm8150b_gpio5", "pm8150b_gpio6",
			"pm8150b_gpio8", "pm8150b_gpio10",
			"pm8150b_gpio12";
	gpio-controller;
	#gpio-cells = <2>;
	qcom,gpios-disallowed = <3 4 7 9 11>;


	pinctrl-names = "default";
	pinctrl-0 = <//&pm8150b_qi_vcc_en_default
				//&pm8150b_qi_rst_default
				&pm8150b_thrmo_en_default
				&pm8150b_gpio6_dig_in_default
				//&pm8150b_qi_addet_state_default
				//&pm8150b_qi_en1_default
				&pm8150b_qi_en2_default>;
};

/*****************************************/
/*  pm8150b_vadc:spmi-adc5               */
/*****************************************/

/*****************************************/
/*  pm8150b_adc_tm:adc-tm5               */
/*****************************************/

/*****************************************/
/*  pm8150b_charger:qpnp-smb5            */
/*****************************************/

/*****************************************/
/*  thermal_zones                        */
/*****************************************/
