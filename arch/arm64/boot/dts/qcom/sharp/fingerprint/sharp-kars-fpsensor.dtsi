/* Copyright (c) 2016-2017, The Linux Foundation. All rights reserved.
 *
 * This program is free software; you can redistribute it and/or modify
 * it under the terms of the GNU General Public License version 2 and
 * only version 2 as published by the Free Software Foundation.
 *
 * This program is distributed in the hope that it will be useful,
 * but WITHOUT ANY WARRANTY; without even the implied warranty of
 * MERCHANTABILITY or FITNESS FOR A PARTICULAR PURPOSE.  See the
 * GNU General Public License for more details.
 */

&soc {

	fpc1291 {
		status = "ok";
		compatible = "fpc,fpc1291";
		input-device-name = "fpc1291";
		interrupt-parent = <&tlmm>;
		interrupts = <118 0x0>;
		fpc,gpio_rst    = <&tlmm 152 0>;
		fpc,gpio_irq    = <&tlmm 118 0>;
		fpc,gpio_pwr    = <&tlmm 116 0>;
		/* vcc_spi-supply  = <none>; */
		/*vdd_io-supply   = <&pm8150_s5>;*/
		/* vdd_ana-supply  = <none>; */
		fpc,enable-on-boot;
		/* fpc,enable-wakeup; */

		pinctrl-names = "fpc1291_reset_reset",
				"fpc1291_reset_active",
				"fpc1291_irq_active",
				"fpc1291_vcc_power_en";

		pinctrl-0 = <&fpc_reset_reset>;
		pinctrl-1 = <&fpc_reset_active>;
		pinctrl-2 = <&fpc_irq_active>;
		pinctrl-3 = <&fpc_vcc_power_en>;
	};

};

