## drivers/input/touchscreen/shtps/sy3000/Kconfig
```kconfig
#
# Sharp Touchscreen configuration
#

if TOUCHSCREEN_SHARP_TPS

	config SHARP_TPS_SY3X00_DEV
		tristate "SY3x00 Device"
		default n
		depends on TOUCHSCREEN_SHARP_TPS

	config SHARP_TPS_SY3700_CUSPRJ_2695
		tristate "SY3700 CUSPRJ-2695"
		default n
		depends on SHARP_TPS_SY3X00_DEV

endif # TOUCHSCREEN_SHARP_TPS
```

## drivers/misc/proximity_light/Kconfig
```kconfig
#
# Sensor drivers configuration
#
# drivers/misc/proximity_light/Kconfig

menuconfig  PROX_LIGHT
	bool "Proximity_Light Sensor Configuration"

if PROX_LIGHT
config SHARP_PROXIMITY_CHECKER
	tristate "Proximity checker driver"
	default n

endif
```

## drivers/misc/shbatt/Kconfig
```kconfig
#
# Battery Control Configuration
#

menu "SHARP Battery Driver"

comment "Battery Control Configuration"

config SHARP_BATTERY_MODULE
	tristate "SHARP Battery Module Support"
	default n

config PM_SUPPORT_BATT_TRACEABILITY
	bool "SHARP Battery traceability"
	default n

config PM_SUPPORT_QI_INPUT_VOLTAGE_REGULATION
	bool "SHARP Qi drivers input voltage regulation"
	default n

endmenu
```
