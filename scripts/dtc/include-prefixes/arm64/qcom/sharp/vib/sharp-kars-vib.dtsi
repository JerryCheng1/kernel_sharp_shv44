/* Copyright (c) 2018, The Linux Foundation. All rights reserved.
 *
 * This program is free software; you can redistribute it and/or modify
 * it under the terms of the GNU General Public License version 2 and
 * only version 2 as published by the Free Software Foundation.
 *
 * This program is distributed in the hope that it will be useful,
 * but WITHOUT ANY WARRANTY; without even the implied warranty of
 * MERCHANTABILITY or FITNESS FOR A PARTICULAR PURPOSE.  See the
 * GNU General Public License for more details.
 */

&pm8150b_haptics {	
	qcom,vmax-mv = <1972>;
	qcom,play-rate-us = <4255>;

	wf_0 {
		qcom,wf-vmax-mv = <1972>;
		qcom,wf-play-rate-us = <4255>;
		qcom,wf-brake-pattern = [03 02 01 00];
		/delete-property/ qcom,lra-auto-resonance-disable;
	};

	/delete-node/ wf_1;
	/delete-node/ wf_2;
	/delete-node/ wf_3;
	/delete-node/ wf_4;
	/delete-node/ wf_5;
};


