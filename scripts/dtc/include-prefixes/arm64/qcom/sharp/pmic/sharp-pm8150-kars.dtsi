/*
 * Copyright (c) 2017-2018, The Linux Foundation. All rights reserved.
 *
 * This program is free software; you can redistribute it and/or modify
 * it under the terms of the GNU General Public License version 2 and
 * only version 2 as published by the Free Software Foundation.
 *
 * This program is distributed in the hope that it will be useful,
 * but WITHOUT ANY WARRANTY; without even the implied warranty of
 * MERCHANTABILITY or FITNESS FOR A PARTICULAR PURPOSE.  See the
 * GNU General Public License for more details.
 */

#include <dt-bindings/gpio/gpio.h>
#include <dt-bindings/input/qcom,qpnp-power-on.h>
#include <dt-bindings/regulator/qcom,rpmh-regulator.h>

/*****************************************/
/*  pm8150: qcom,pm8150 alias            */
/*****************************************/

/*****************************************/
/*  pm8150-gpios: qpnp-pin               */
/*****************************************/
&pm8150_gpios {
	compatible = "qcom,spmi-gpio";
	reg = <0xc000 0xa00>;
	interrupts = <0x0 0xc0 0 IRQ_TYPE_NONE>,
			<0x0 0xc1 0 IRQ_TYPE_NONE>,
			<0x0 0xc2 0 IRQ_TYPE_NONE>,
			<0x0 0xc3 0 IRQ_TYPE_NONE>,
			<0x0 0xc4 0 IRQ_TYPE_NONE>,
			<0x0 0xc5 0 IRQ_TYPE_NONE>,
			<0x0 0xc6 0 IRQ_TYPE_NONE>,
			<0x0 0xc8 0 IRQ_TYPE_NONE>,
			<0x0 0xc9 0 IRQ_TYPE_NONE>;
	interrupt-names = "pm8150_gpio1", "pm8150_gpio2",
			"pm8150_gpio3", "pm8150_gpio4",
			"pm8150_gpio5", "pm8150_gpio6",
			"pm8150_gpio7", "pm8150_gpio9",
			"pm8150_gpio10";
	gpio-controller;
	#gpio-cells = <2>;
	qcom,gpios-disallowed = <8>;

	pinctrl-names = "default";
	pinctrl-0 = <&pm8150_google_assist_key_default
				&pm8150_gpio2_dig_in_default
				&pm8150_lcd_clk_default
				&pm8150_option_1_default
				&pm8150_down_key_default
				&pm8150_gpio7_dig_in_default
				&pm8150_gpio9_dig_in_default
				&pm8150_gpio10_dig_in_default>;
};

/*****************************************/
/*  pm8150: rpm-regulator                */
/*****************************************/

/*****************************************/
/*  SHARP Device Drivers                 */
/*****************************************/
